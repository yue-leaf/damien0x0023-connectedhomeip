## CMakeLists.txt
```
cmake_minimum_required(VERSION 3.13.1)
find_package(Zephyr REQUIRED HINTS $ENV{ZEPHYR_BASE})
project(template LANGUAGES C VERSION 1.0.0)

configure_file(app_version.h.in ${CMAKE_BINARY_DIR}/template/include/app_version.h)
target_include_directories(app PRIVATE ${CMAKE_BINARY_DIR}/template/include src proj/rtl87x2g)

target_sources(app PRIVATE src/main_ns.c src/app_task.c)

if (CONFIG_CODE_DATA_RELOCATION AND CONFIG_SOC_SERIES_RTL87X2G)
zephyr_code_relocate(LIBRARY kernel LOCATION ITCM_TEXT)
zephyr_code_relocate(FILES ${ZEPHYR_BASE}/kernel/xip.c LOCATION FLASH_TEXT NOCOPY)
zephyr_code_relocate(FILES ${ZEPHYR_BASE}/drivers/timer/cortex_m_systick.c LOCATION ITCM_TEXT)
zephyr_code_relocate(FILES ${ZEPHYR_BASE}/arch/${ARCH}/core/aarch32/swap.c LOCATION ITCM_TEXT)
zephyr_code_relocate(FILES ${ZEPHYR_BASE}/arch/${ARCH}/core/aarch32/swap_helper.S LOCATION ITCM_TEXT)
zephyr_code_relocate(FILES ${ZEPHYR_BASE}/arch/${ARCH}/core/aarch32/isr_wrapper.S LOCATION ITCM_TEXT)
zephyr_code_relocate(FILES ${ZEPHYR_BASE}/arch/${ARCH}/core/aarch32/cortex_m/exc_exit.S LOCATION ITCM_TEXT)
endif()
```

## prj.conf
```kconfig
# This file contains selected Kconfig options for the application.
CONFIG_SENSOR=y
```

## debug.conf
```kconfig
# This is a Kconfig fragment which can be used to enable debug-related options
# in the application. See the README for more details.

# compiler
CONFIG_DEBUG_OPTIMIZATIONS=y

# console
CONFIG_CONSOLE=y

# UART console
CONFIG_SERIAL=y
CONFIG_UART_CONSOLE=y

# logging
CONFIG_LOG=y
CONFIG_APP_LOG_LEVEL_DBG=y
```

## src/app_task.c
```c
/**
*****************************************************************************************
*     Copyright(c) 2017, Realtek Semiconductor Corporation. All rights reserved.
*****************************************************************************************
   * @file      app_task.c
   * @brief     Routines to create App task and handle events & messages
   * @author    jane
   * @date      2017-06-02
   * @version   v1.0
   **************************************************************************************
   * @attention
   * <h2><center>&copy; COPYRIGHT 2017 Realtek Semiconductor Corporation</center></h2>
   **************************************************************************************
  */

/*============================================================================*
 *                              Header Files
 *============================================================================*/
#include <os_msg.h>
#include <os_task.h>
#include <os_sched.h>
#include <app_task.h>

/*============================================================================*
 *                              Macros
 *============================================================================*/
#define configMINIMAL_SECURE_STACK_SIZE  1024
//! Task priorities
#define APP_TASK_PRIORITY             1
//!Task stack size
#define APP_TASK_STACK_SIZE           256 * 8

/*============================================================================*
 *                              Variables
 *============================================================================*/
void *app_task_handle;   //!< APP Task handle

/*============================================================================*
 *                              Functions
 *============================================================================*/
void app_main_task(void *p_param);

/**
 * @brief  Initialize App task
 * @return void
 */
void app_task_init()
{
    os_task_create(&app_task_handle, "app", app_main_task, 0, APP_TASK_STACK_SIZE,
                   APP_TASK_PRIORITY);
}

/**
 * @brief        App task to handle events & messages
 * @param[in]    p_params    Parameters sending to the task
 * @return       void
 */
void app_main_task(void *p_param)
{
    /* This task calls secure side functions. So allocate a secure context for
     * it. */
    //must locate at the first line
    os_alloc_secure_ctx(configMINIMAL_SECURE_STACK_SIZE);

    /* avoid ppt initialization conflict with ble psd procedure */
    os_delay(1000);

    void ppt_demo(void);
    ppt_demo();

    while (1);
}
```

## src/main_ns.c
```c
/**
*****************************************************************************************
*     Copyright(c) 2022, Realtek Semiconductor Corporation. All rights reserved.
*****************************************************************************************
* @file
* @brief
* @author
* @date
* @version
**************************************************************************************
* @attention
* <h2><center>&copy; COPYRIGHT 2022 Realtek Semiconductor Corporation</center></h2>
**************************************************************************************
*/

/* Demo includes. */
#include "rtl876x.h"
#include "rtl876x_lib_platform.h"
#include "rtl_pinmux.h"
#include "app_section.h"
#include "app_task.h"
#include "pm.h"
#include "io_dlps.h"
#include "utils.h"
#include "board.h"
#include "patch_header_check.h"
#include "flash_nor_device.h"
#include "os_sched.h"
#include "trace.h"
#include "ppt_driver.h"

void non_secure_callback(void)
{
    DBG_DIRECT("Non-Secure World: callback");
}

#if DLPS_EN
DATA_RAM_FUNCTION POWER_CheckResult app_dlps_check_cb(void)
{
    DBG_DIRECT("CHECK");
    return POWER_CHECK_PASS;
}

DATA_RAM_FUNCTION void app_dlps_enter_cb(void)
{
    DBG_DIRECT("ENTER");
}

DATA_RAM_FUNCTION void app_dlps_exit_cb(void)
{
    DBG_DIRECT("EXIT");
}

DATA_RAM_FUNCTION void System_Handler(void)
{
    DBG_DIRECT("SYS");
    Pad_ClearAllWakeupINT();
}

/******************************************************************
 * @brief  pwr_mgr_init() contains the setting about power mode.
 * @param  none
 * @return none
 * @retval void
 */
void pwr_mgr_init(void)
{
    /* ppt dlps init */
    ppt_dlps_init();
    /* platform dlps init */
    power_check_cb_register(app_dlps_check_cb);
    DLPS_IORegUserDlpsEnterCb(app_dlps_enter_cb);
    DLPS_IORegUserDlpsExitCb(app_dlps_exit_cb);
    DLPS_IORegister();
    bt_power_mode_set(BTPOWER_DEEP_SLEEP);
    power_mode_set(POWER_DLPS_MODE);
}
#endif

/* Non-Secure main. */
int main(void)
{
    DBG_DIRECT("Non-Secure World: main");

#if DLPS_EN
    pwr_mgr_init();
#endif

    app_task_init();

    /* Start scheduler. */
    os_sched_start();

    /* Should not reach here as the scheduler is already started. */
    for (; ;)
    {
    }
}
```

## src/ppt_cfg.c
```c
#include "trace.h"
#include "ppt_cfg.h"
#include "ppt_simple.h"

void ppt_cfg(void)
{
    uint16_t frequency = FREQUENCY;
    uint8_t bank, channel;
    ppt_get_bank_channel(frequency, &bank, &channel);
    APP_PRINT_INFO3("ppt_cfg: %dMHz %d %d", frequency, bank, channel);

    ppt_init();

    {
        ppt_phy_param_t param =
        {
            .rx_phy = PHY_TYPE
        };
        param.bank = bank;
        param.channel = channel;
        ppt_set_phy_param(&param);
    }

    {
        ppt_phy_entry_param_t param =
        {
            .preamble_len = PREAMBLE_LEN,
            .tx_phy = PHY_TYPE
        };
        ppt_set_phy_entry_param(0, &param);
    }

    {
        ppt_white_entry_param_t param =
        {
            .len = 7,
            .value = {0x91, 0x53}
        };
        int8_t logic_idx = ppt_get_ble_logic_chan(bank, channel);
        if (logic_idx >= 0)
        {
            param.value.init = ppt_get_ble_white_init(logic_idx);
        }
        ppt_set_white_entry_param(0, &param);
    }

    {
        ppt_pkt_format_t param =
        {
            .addr_len = ACCESS_ADDRESS_LEN,
            .hp_len = HEADER_PREFIX_LEN * 8,
            .length_len = HEADER_LENGTH_LEN * 8,
            .hs_len = HEADER_SUFFIX_LEN * 8,
            .header_order = BIT_ORDER,
            .payload_order = BIT_ORDER
        };
        ppt_set_pkt_format(&param);
    }

    {
        ppt_crc_param_t param =
        {
            .len = CRC_LEN,
            .include_addr = false
        };
        ppt_set_crc_param(&param);
    }

    {
        ppt_crc_entry_param_t param =
        {
            .value = {0x0100065b, 0x555555}
        };
        ppt_set_crc_entry_param(0, &param);
    }

    {
        ppt_tx_addr_t param =
        {
            .tx_addr = {ACCESS_ADDRESS}
        };
        ppt_set_tx_addr(0, &param);
    }

    {
        ppt_rx_addr_t param =
        {
            .enable = true,
            .rx_addr = {ACCESS_ADDRESS}
        };
        ppt_set_rx_addr(0, &param);
    }

#if TURNAROUND_DELAY != 0
    ppt_set_tifs(TURNAROUND_DELAY);
#endif

    ppt_set_tx_power_dbm(4);
}
```

## src/ppt_cfg.h
```c
/**
*****************************************************************************************
*     Copyright(c) 2021, Realtek Semiconductor Corporation. All rights reserved.
*****************************************************************************************
   * @file      ppt_cfg.h
   * @brief     ppt demo common setting
   * @author    bill
   * @date      2021-11-16
   * @version   v1.0
   **************************************************************************************
   * @attention
   * <h2><center>&copy; COPYRIGHT 2021 Realtek Semiconductor Corporation</center></h2>
   **************************************************************************************
  */
#ifndef _PPT_CFG_H_
#define _PPT_CFG_H_

#include <stdint.h>

#ifdef __cplusplus
extern "C" {
#endif

/** @defgroup PPT_CFG ppt configuration
  * @brief
  * @{
  */

#define FREQUENCY               2402 //!< unit of MHz
#define PHY_TYPE                PPT_PHY_TYPE_BLE_1M
#define PREAMBLE_LEN            1
#define ACCESS_ADDRESS_LEN      4
#define HEADER_PREFIX_LEN       1
#define HEADER_LENGTH_LEN       1
#define HEADER_SUFFIX_LEN       0
#define PDU_HEADER_LEN          PPT_RX_FIFO_HEADER_SIZE_BYTE(HEADER_PREFIX_LEN, HEADER_LENGTH_LEN, HEADER_SUFFIX_LEN)
#define CRC_LEN                 3
#define BIT_ORDER               PPT_FIELD_BIT_ORDER_LSB
#define ACCESS_ADDRESS          0xd6, 0xbe, 0x89, 0x8e

#define ACK_MODE                1
#define ONESHOT_MODE            0
#define TURNAROUND_DELAY        0

/**
 * @brief  Configure the radio basic parameters
 * @return none
 */
void ppt_cfg(void);

/** End of PPT_CFG
* @}
*/

#ifdef __cplusplus
}
#endif

#endif
```

## src/ppt_prx.c
```c
#include "trace.h"
#include "ppt_simple.h"
#include "ppt_cfg.h"
#include "os_sched.h"

volatile uint32_t rx_int_num;
volatile uint32_t rx_num;
volatile uint32_t tx_num;

static PPT_ISR_SECTION void ppt_isr_handler(void)
{
    PRO_MISR_TYPE reg_misr;
    reg_misr.d16 = RD_PPT_REG(PRO_MISR);
    APP_PRINT_INFO1("ppt_isr_handler: 0x%04x", reg_misr.d16);

    if (reg_misr.rx_int)
    {
        rx_int_num += 1;
        /* read concerned rx stack registers before pop rx stack */
        PRO_RSSI_TYPE rssi = {.d16 = RD_PPT_REG(PRO_RSSI)};
        PRO_LENGTH_TYPE rx_length = {.d16 = RD_PPT_REG(PRO_LENGTH)};
        PRO_RX_STACK_TYPE rx_stack = {.d16 = RD_PPT_REG(PRO_RX_STACK)};
        PRO_RX_HP_TYPE rx_hp = {.d16 = RD_PPT_REG(PRO_RX_HP)};
        PRO_ACCHIT_CLK_LOWER_TYPE acchit_clk_lower = {.d16 = RD_PPT_REG(PRO_ACCHIT_CLK_LOWER)};
        PRO_ACCHIT_CLK_UPPER_TYPE acchit_clk_upper = {.d16 = RD_PPT_REG(PRO_ACCHIT_CLK_UPPER)};
        PRO_RX_CRC_LOWER_TYPE rx_crc_lower = {.d16 = RD_PPT_REG(PRO_RX_CRC_LOWER)};
        PRO_RX_CRC_UPPER_TYPE rx_crc_upper = {.d16 = RD_PPT_REG(PRO_RX_CRC_UPPER)};
        PRO_RX_HS_LOWER_TYPE rx_hs_lower = {.d16 = RD_PPT_REG(PRO_RX_HS_LOWER)};
        /* pop rx stack */
        PRO_RX_HS_UPPER_TYPE rx_hs_upper = {.d16 = RD_PPT_REG(PRO_RX_HS_UPPER)};
        uint32_t rx_hs = rx_hs_lower.hs_15_0 + (rx_hs_upper.hs_30_16 << 16);
        if (rx_stack.rx_abort_rd)
        {
            APP_PRINT_ERROR0("prx: rx abort");
        }
        else if (rx_stack.rx_time_out || rx_stack.rx_hit == false)
        {
            APP_PRINT_ERROR0("prx: rx timeout");
        }
        else if (rx_stack.is_crc_error)
        {
            APP_PRINT_ERROR0("prx: rx crc error");
        }
        else
        {
            rx_num += 1;
            uint8_t rx_entry = PPT_RX_STACK_ENTRY(rx_stack);
            uint16_t rx_len = rx_length.d16 + PDU_HEADER_LEN;
            uint8_t *rx_buffer = ppt_pop_rx_data_by_entry(rx_entry, rx_len);
            APP_PRINT_INFO8("prx: rx count %d, int count %d, rx stack 0x%04x, entry %d, hp 0x%02x, len %d, hs 0x%08x, payload %b",
                            rx_num, rx_int_num, rx_stack.d16, rx_entry,
                            rx_hp.hp, rx_length.d16, rx_hs, TRACE_BINARY(rx_length.d16, rx_buffer + PDU_HEADER_LEN));
        }

        if (ppt_ctx->oneshot)
        {
            if (ppt_ctx->ack == false || rx_stack.rx_time_out)
            {
                ppt_ctx->fsm = PPT_FSM_STANDBY;
                ppt_ctx->sync_flag = false;
            }
        }
    }

    if (reg_misr.tx_int)
    {
        tx_num += 1;
        /* read concerned tx stack registers before pop tx stack */
        PRO_TX_STACK_TYPE tx_stack = {.d16 = RD_PPT_REG(PRO_TX_STACK)};
        PRO_TX_HS_LOWER_TYPE tx_hs_lower = {.d16 = RD_PPT_REG(PRO_TX_HS_LOWER)};
        PRO_TX_HS_UPPER_TYPE tx_hs_upper = {.d16 = RD_PPT_REG(PRO_TX_HS_UPPER)};
        uint32_t tx_hs = tx_hs_lower.tx_hs_15_0 + (tx_hs_upper.tx_hs_30_16 << 16);
        PRO_TX_CLK_LOWER_TYPE tx_clk_lower = {.d16 = RD_PPT_REG(PRO_TX_CLK_LOWER)};
        PRO_TX_CLK_UPPER_TYPE tx_clk_upper = {.d16 = RD_PPT_REG(PRO_TX_CLK_UPPER)};
        /* pop tx stack */
        PRO_TX_LENGTH_TYPE tx_length = {.d16 = RD_PPT_REG(PRO_TX_LENGTH)};
        uint8_t tx_entry = PPT_TX_STACK_ENTRY(tx_stack, tx_length);
        APP_PRINT_INFO8("prx: tx count %d, stack no tx %d empty %d tptr %d, entry %d, hp 0x%02x, len %d, hs 0x%08x",
                        tx_num, tx_stack.is_no_tx, tx_stack.is_empty, tx_stack.tx_ptr, tx_entry,
                        tx_stack.tx_hp, tx_length.tx_length, tx_hs);

        if (ppt_ctx->oneshot)
        {
            ppt_ctx->fsm = PPT_FSM_STANDBY;
            ppt_ctx->sync_flag = false;
        }
    }

    if (reg_misr.kill_prx_int)
    {
        WR_PPT_REG(PRO_MISR, BIT5);
        ppt_flush_rx_fifo();
        ppt_ctx->fsm = PPT_FSM_STANDBY;
        ppt_ctx->sync_flag = false;
    }
}

void ppt_demo(void)
{
    ppt_cfg();
    ppt_reg_handler(ppt_isr_handler);

    /*
     * psd sample code
     * get the channel rssi of different frequencies from 2402 to 2480 MHz
     */
    for (uint8_t loop = 0; loop < 79; loop++)
    {
        ppt_psd_mode_ext_t param =
        {
            {
                .chann_start = loop,
                .chann_stop = loop,
                .chann_step = 1,
                .mode = 0,
                .timeout = PSD_TIMEOUT_DEFAULT
            }
        };
        ppt_set_psd_mode_ext(&param);
        ppt_enable_psd(NULL);
    }
    for (uint8_t loop = 0; loop < 79; loop++)
    {
        int16_t rssi = ppt_get_psd_result(loop);
        DBG_DIRECT("PSD: freq %dMHz rssi = %ddBm", 2402 + loop, rssi);
    }

    /* prx setting */
    {
        ppt_prx_mode_ext_t param =
        {
            {
                .ack_mode = ACK_MODE,
                .continuous_mode = !ONESHOT_MODE //!< oneshot & continuous mode switch
            }
        };
        ppt_set_prx_mode_ext(&param);
    }

    {
        ppt_header_t param =
        {
            .hp = 3 //!< BLE PDU type: SCAN_REQ
        };
        ppt_set_tx_header(0, &param);
    }

    uint8_t data[] =
    {
        0x02, 0x02, 0x01, 0x02, 0x1, 0x1, //!< ScanA
        0x01, 0x02, 0x01, 0x02, 0x1, 0x1 //!< AdvA
    };
    ppt_push_tx_data(sizeof(data), data);

    if (ppt_ctx->oneshot)
    {
        while (1)
        {
            ppt_enable_prx(0);
            /* delay for print log */
            os_delay(10);
        }
    }
    else
    {
        /* use async mode to exit while loop and print log */
        ppt_enable_prx(ppt_async_cb_template);
        while (1)
        {
            os_delay(10);
        }
    }
}
```

## src/ppt_ptx.c
```c
#include <stdio.h>
#include "trace.h"
#include "ppt_simple.h"
#include "ppt_cfg.h"
#include "os_sched.h"

volatile uint32_t tx_num;
volatile uint32_t rx_num;

static PPT_ISR_SECTION void ppt_isr_handler(void)
{
    PRO_MISR_TYPE reg_misr;
    reg_misr.d16 = RD_PPT_REG(PRO_MISR);
    APP_PRINT_INFO1("ppt_isr_handler: 0x%04x", reg_misr.d16);

    if (reg_misr.tx_early_int)
    {
        WR_PPT_REG(PRO_MISR, BIT2);
    }

    if (reg_misr.tx_int)
    {
        tx_num += 1;
        /* read concerned tx stack registers before pop tx stack */
        PRO_TX_STACK_TYPE tx_stack = {.d16 = RD_PPT_REG(PRO_TX_STACK)};
        PRO_TX_HS_LOWER_TYPE tx_hs_lower = {.d16 = RD_PPT_REG(PRO_TX_HS_LOWER)};
        PRO_TX_HS_UPPER_TYPE tx_hs_upper = {.d16 = RD_PPT_REG(PRO_TX_HS_UPPER)};
        uint32_t tx_hs = tx_hs_lower.tx_hs_15_0 + (tx_hs_upper.tx_hs_30_16 << 16);
        PRO_TX_CLK_LOWER_TYPE tx_clk_lower = {.d16 = RD_PPT_REG(PRO_TX_CLK_LOWER)};
        PRO_TX_CLK_UPPER_TYPE tx_clk_upper = {.d16 = RD_PPT_REG(PRO_TX_CLK_UPPER)};
        /* pop tx stack */
        PRO_TX_LENGTH_TYPE tx_length = {.d16 = RD_PPT_REG(PRO_TX_LENGTH)};
        uint8_t tx_entry = PPT_TX_STACK_ENTRY(tx_stack, tx_length);
        APP_PRINT_INFO8("ptx: tx count %d, stack no tx %d empty %d tptr %d, entry %d, hp 0x%02x, len %d, hs 0x%08x",
                        tx_num, tx_stack.is_no_tx, tx_stack.is_empty, tx_stack.tx_ptr, tx_entry,
                        tx_stack.tx_hp, tx_length.tx_length, tx_hs);

        if (ppt_ctx->ack == false)
        {
            if (ppt_ctx->retransmit_counter == 0)
            {
                ppt_trigger_fw_ack(tx_stack.tx_entry_1_0);
                if (ppt_ctx->oneshot)
                {
                    ppt_ctx->fsm = PPT_FSM_STANDBY;
                    ppt_ctx->sync_flag = false;
                }
                else
                {
                    ppt_execute_instruction(PPT_HW_INSTRUCTION_PTX_DISABLE);
                }
            }
            else
            {
                ppt_ctx->retransmit_counter -= 1;
            }
        }
    }

    if (reg_misr.rx_int)
    {
        /* read concerned rx stack registers before pop rx stack */
        PRO_RSSI_TYPE rssi = {.d16 = RD_PPT_REG(PRO_RSSI)};
        PRO_LENGTH_TYPE rx_length = {.d16 = RD_PPT_REG(PRO_LENGTH)};
        PRO_RX_STACK_TYPE rx_stack = {.d16 = RD_PPT_REG(PRO_RX_STACK)};
        PRO_RX_HP_TYPE rx_hp = {.d16 = RD_PPT_REG(PRO_RX_HP)};
        PRO_ACCHIT_CLK_LOWER_TYPE acchit_clk_lower = {.d16 = RD_PPT_REG(PRO_ACCHIT_CLK_LOWER)};
        PRO_ACCHIT_CLK_UPPER_TYPE acchit_clk_upper = {.d16 = RD_PPT_REG(PRO_ACCHIT_CLK_UPPER)};
        PRO_RX_CRC_LOWER_TYPE rx_crc_lower = {.d16 = RD_PPT_REG(PRO_RX_CRC_LOWER)};
        PRO_RX_CRC_UPPER_TYPE rx_crc_upper = {.d16 = RD_PPT_REG(PRO_RX_CRC_UPPER)};
        PRO_RX_HS_LOWER_TYPE rx_hs_lower = {.d16 = RD_PPT_REG(PRO_RX_HS_LOWER)};
        /* pop rx stack */
        PRO_RX_HS_UPPER_TYPE rx_hs_upper = {.d16 = RD_PPT_REG(PRO_RX_HS_UPPER)};
        uint32_t rx_hs = rx_hs_lower.hs_15_0 + (rx_hs_upper.hs_30_16 << 16);
        if (rx_stack.rx_abort_rd)
        {
            APP_PRINT_ERROR0("ptx: rx abort");
        }
        else if (rx_stack.rx_time_out || rx_stack.rx_hit == false)
        {
            APP_PRINT_ERROR0("ptx: rx timeout");
        }
        else if (rx_stack.is_crc_error)
        {
            APP_PRINT_ERROR0("ptx: rx crc error");
        }
        else
        {
            rx_num += 1;
            uint8_t rx_entry = PPT_RX_STACK_ENTRY(rx_stack);
            uint16_t rx_len = rx_length.d16 + PDU_HEADER_LEN;
            uint8_t *rx_buffer = ppt_pop_rx_data_by_entry(rx_entry, rx_len);
            APP_PRINT_INFO7("ptx: rx count %d, rx stack 0x%04x, entry %d, hp 0x%02x, len %d, hs 0x%08x, payload %b",
                            rx_num, rx_stack.d16, rx_entry, rx_hp.hp, rx_length.d16, rx_hs, TRACE_BINARY(rx_length.d16,
                                    rx_buffer + PDU_HEADER_LEN));
        }

        if (ppt_ctx->retransmit_counter == 0)
        {
            ppt_trigger_fw_ack(rx_stack.entry_0);
            if (ppt_ctx->oneshot)
            {
                ppt_ctx->fsm = PPT_FSM_STANDBY;
                ppt_ctx->sync_flag = false;
            }
            else
            {
                ppt_execute_instruction(PPT_HW_INSTRUCTION_PTX_DISABLE);
            }
        }
        else
        {
            ppt_ctx->retransmit_counter -= 1;
        }

        /* statistics of response miss rate */
        char rate[10];
        sprintf(rate, "%u.%03u%%", (tx_num - rx_num) * 100 / tx_num,
                (tx_num - rx_num) * 100000 / tx_num % 1000);
        APP_PRINT_INFO4("ptx: statistics tx %d, rx %d, miss %d(%s)", tx_num, rx_num, tx_num - rx_num,
                        TRACE_STRING(rate));
    }

    if (reg_misr.kill_ptx_int)
    {
        WR_PPT_REG(PRO_MISR, BIT4);
        ppt_flush_rx_fifo();
        ppt_ctx->fsm = PPT_FSM_STANDBY;
        ppt_ctx->sync_flag = false;
    }
}

void ppt_demo(void)
{
    ppt_cfg();
    ppt_reg_handler(ppt_isr_handler);

    {
        ppt_ptx_mode_ext_t param =
        {
            {
                .ack_mode = ACK_MODE,
                .periodic_mode = !ONESHOT_MODE, //!< oneshot & periodic mode switch
                .periodic_interval = 7
            },
            .retransmit_times = 1
        };
        ppt_set_ptx_mode_ext(&param);
    }

    {
        ppt_header_t param =
        {
            .hp = 0 //!< BLE PDU type: ADV_IND
        };
        ppt_set_tx_header(0, &param);
    }

    uint8_t data[] =
    {
        0x01, 0x02, 0x01, 0x02, 0x1, 0x1, //!< AdvA
        /* advertising data */
        0x2, 0x1, 0x5, //!< flags
        0x5, 0x9, '2', '.', '4', 'g' //!< complete local name
    };
    uint8_t len = sizeof(data);

    while (1)
    {
        ppt_push_tx_data(len, data);
        ppt_enable_ptx(0);

        /* modify data content and data length for test */
        data[sizeof(data) - 1] += 1;
        len += 1;
        if (len > sizeof(data))
        {
            len = 6; // reserved 6 bytes for the AdvA (Advertiser Address) field in the BLE Adv PDU
        }

        /* delay for periodic mode */
        if (ppt_ctx->oneshot == false)
        {
            os_delay(100);
        }
    }
}
```
